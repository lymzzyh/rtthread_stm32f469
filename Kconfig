## Kconfig
```kconfig
mainmenu "RT-Thread Configuration"

config $BSP_DIR
    string
    option env="BSP_ROOT"
    default "."

config $RTT_DIR
    string
    default "rt-thread"

config $PKGS_DIR
    string
    option env="PKGS_ROOT"
    default "packages"

source "$RTT_DIR/Kconfig"
source "$PKGS_DIR/Kconfig"

config SOC_STM32F469NI
    bool 
    select ARCH_ARM_CORTEX_M4
    default y

menu "STM32 Bsp Config" 

choice
    prompt "Heap select"
    default BSP_USING_HEAP_SRAM_SDRAM
    config BSP_USING_HEAP_SRAM
        bool "310K sram"
    config BSP_USING_HEAP_SRAM_SDRAM
        bool "310K sram + 8MB sdram"
        select BSP_USING_SDRAM
endchoice

menu "Select uart drivers"
    config BSP_USING_UART1
        bool "Using uart1"
        select RT_USING_SERIAL
        default n    

    config BSP_USING_UART2
        bool "Using uart2"
        select RT_USING_SERIAL
        default n    

    config BSP_USING_UART3
        bool "Using uart3"
        select RT_USING_SERIAL
        default y   

    config BSP_USING_UART6
        bool "Using uart6"
        select RT_USING_SERIAL
        default n   
endmenu

menu "Select pin drivers"
    config BSP_USING_PIN
        bool "Using pin"
        select RT_USING_PIN
        default y 
endmenu

menu "Select i2c bus drivers"
    config BSP_USING_I2C2
        bool "Using i2c2(Pin simulation)"
        select RT_USING_I2C
        select RT_USING_I2C_BITOPS
        default n 
endmenu

menu "Select spi bus drivers"
    config BSP_USING_SPI1
        bool "Using spi1 bus"
        select RT_USING_SPI
        default n 

    config BSP_USING_SPI2
        bool "Using spi2 bus"
        select RT_USING_SPI
        default n  

    config BSP_USING_SPI3
        bool "Using spi3 bus"
        select RT_USING_SPI
        default n 
endmenu

menu "Select sdram drivers"
    config BSP_USING_SDRAM
        bool "Using 16mbytes sdram" 
        default n 
endmenu

menu "Select audio drivers"
    config BSP_USING_AUDIO
        bool "Using audio" 
        default n 
endmenu

if !PKG_USING_STM32_SDIO
menu "Select sdcard drivers"
    config BSP_USING_SDCARD
        bool "Using sdcard(block device)" 
        default y 

    config BSP_USING_SDCARD_MOUNT
        bool "Enable sdcard mount" 
        default y 
        depends on BSP_USING_SDCARD
    
    config BSP_USING_SDCARD_PATH
        string "Path of sdcard mount"
        default "/mnt/sd" 
        depends on BSP_USING_SDCARD 
endmenu
endif

menu "Select lcd drivers"
    config BSP_USING_LCD
        bool "Using lcd" 
        default n 
        select BSP_USING_SDRAM
endmenu

config PKG_USING_OPTPARSE
    bool "Select optparse pkg" 
    default y 

config PKG_USING_LIBTEST
    bool "Select libtest pkg" 
    default y 

endmenu 
```
